## examples/publisher_hih6130/Kconfig
```kconfig
config UROS_EXAMPLES_PUBLISHER_HIH6130
	bool "uROS Publisher HIH6130"
	default n
	depends on UROS
	---help---
		Enable the publisher uROS example for HIH6130 sensor

if UROS_EXAMPLES_PUBLISHER_HIH6130

config UROS_EXAMPLES_PUBLISHER_HIH6130_PROGNAME
	string "Program name"
	default "publisher_hih6130"
	depends on BUILD_KERNEL
	---help---
		This is the name of the program that will be use when the NSH ELF
		program is installed.

#config UROS_EXAMPLES_PUBLISHER_HIH6130_PRIORITY
#	int "Publisher hih6130 task priority"
#	default 100
#
#config UROS_EXAMPLES_PUBLISHER_HIH6130_STACKSIZE
#	int "Publisher hih6130 stack size"
#	default 2048

endif
```

## uros/Kconfig
```kconfig
# Kconfig for micro-ROS

menu "micro-ROS"

config UROS
    bool "Enable micro-ROS"
    default n
    ---help---
        Enable support for micro-ROS 

if UROS

config UROS_DIR
    string "micro-ROS workspace (relative to apps path)"
    default "uros"
    ---help---
	Location of the micro-ROS workspace.

endif

endmenu # UROS
```
